## west.yml
```yaml
manifest:
  remotes:
    - name: zephyrproject
      url-base: https://github.com/zephyrproject-rtos
    - name: royyandzakiy
      url-base: https://github.com/royyandzakiy
    - name: nrfconnect
      url-base: https://github.com/nrfconnect
    - name: anobli
      url-base: https://github.com/anobli

  projects:
    - name: sdk-nrf
      remote: nrfconnect
      revision: v3.2.1
      import: # consider just 'true' to import all
        name-allowlist:
          - sdk-zephyr
          - sdk-nrfxlib
          - mcuboot
          - mbedtls
          - trusted-firmware-m
          - cmsis
          - hal-nordic
      path: ncs

    - name: balancer-robot-firmware
      remote: royyandzakiy
      revision: main
      path: firmware

    - name: balancer-robot-app
      remote: royyandzakiy
      revision: main
      path: desktop-app

    - name: googletest
      remote: anobli
      repo-path: googletest
      revision: 8e3886acac2e6058f4f540269f43b1f4a2700adc

  self:
    path: workspace-manifest
```
